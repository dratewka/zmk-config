/*
 * Copyright (c) 2020 The ZMK Contributors
 *
 * SPDX-License-Identifier: MIT
 */

#include <behaviors.dtsi>
#include <dt-bindings/zmk/keys.h>
#include <dt-bindings/zmk/bt.h>

#define MAIN 0
#define SYM1 1
#define SYM2 2
#define NAV  3
#define SYS  4
#define FUN  5
#define AND  6

#include "behaviors.dtsi"
#include "combos.dtsi"
#include "conditional_layers.dtsi"
#include "keymap.dtsi"
#include "macros.dtsi"