/ {
    behaviors {
        hm: homerow_mods {
            compatible = "zmk,behavior-hold-tap";
            label = "HOMEROW_MODS";
            #binding-cells = <2>;
            tapping-term-ms = <250>;
            quick-tap-ms = <160>;
            flavor = "tap-preferred";
            bindings = <&kp>, <&kp>;
        };
    };
};