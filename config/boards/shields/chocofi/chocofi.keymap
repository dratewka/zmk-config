/*
 * Copyright (c) 2020 The ZMK Contributors
 *
 * SPDX-License-Identifier: MIT
 */

#include <behaviors.dtsi>
#include <dt-bindings/zmk/keys.h>
#include <dt-bindings/zmk/bt.h>

#include "parts/behaviors.dtsi"
#include "parts/combos.dtsi"
#include "parts/keymap.dtsi"
#include "parts/macros.dtsi"