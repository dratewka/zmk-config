/ {
    conditional_layers {
        compatible = "zmk,conditional-layers";
        android_layer {
            if-layers = <SYS NAV>;
            then-layer = <AND>;
        };
        function_layer {
            if-layers = <NAV SYM1>;
            then-layer = <FUN>;
        };
    };
};